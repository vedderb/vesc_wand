## CMakeLists.txt
```
cmake_minimum_required(VERSION 3.13.1)

find_package(Zephyr REQUIRED HINTS $ENV{ZEPHYR_BASE})
project(stick_remote)

# Boards
# nrf52840dk_nrf52840
# nrf52dk_nrf52832

# For the DWM1001
#add_definitions(-DWAND_DW)
#add_definitions(-DSABRE)

# For the wand with magnetic throttle
add_definitions(-DWAND_MAG)

target_sources(app PRIVATE src/main.c)
target_sources(app PRIVATE src/nrf_esb.c)
target_sources(app PRIVATE src/crc.c)
target_sources(app PRIVATE src/utils.c)
target_sources(app PRIVATE src/buffer.c)
target_sources(app PRIVATE src/oled.c)
target_sources(app PRIVATE src/fonts.c)
target_sources(app PRIVATE src/i2c_bb.c)
target_sources(app PRIVATE src/als31300.c)
target_sources(app PRIVATE src/lis2dh12.c)

target_sources(app PRIVATE src/imu/BMI160_driver/bmi160.c)
target_sources(app PRIVATE src/imu/ahrs.c)
target_sources(app PRIVATE src/imu/imu.c)

target_sources(app PRIVATE src/decawave/deca_port.c)
target_sources(app PRIVATE src/decawave/deca_range.c)
target_sources(app PRIVATE src/decawave/deca_range_tables.c)
target_sources(app PRIVATE src/decawave/decadriver/deca_device.c)
target_sources(app PRIVATE src/decawave/decadriver/deca_params_init.c)

zephyr_include_directories(src/)
zephyr_include_directories(src/imu/)
zephyr_include_directories(src/imu/BMI160_driver/)
zephyr_include_directories(src/decawave/)
zephyr_include_directories(src/decawave/decadriver/)
```

## prj.conf
```kconfig
CONFIG_GPIO=y
CONFIG_GPIO_NRF_P0=y

CONFIG_SERIAL=n
CONFIG_BT=n

CONFIG_FPU=y
CONFIG_FPU_SHARING=y
CONFIG_FP_HARDABI=y
CONFIG_SPEED_OPTIMIZATIONS=y

CONFIG_TICKLESS_KERNEL=y
CONFIG_SYS_CLOCK_TICKS_PER_SEC=1000

CONFIG_USE_SEGGER_RTT=y
CONFIG_RTT_CONSOLE=y

CONFIG_NEWLIB_LIBC=y
CONFIG_NEWLIB_LIBC_FLOAT_PRINTF=y
CONFIG_NEWLIB_LIBC_FLOAT_SCANF=y

CONFIG_CLOCK_CONTROL_NRF_K32SRC_XTAL=n
CONFIG_CLOCK_CONTROL_NRF_K32SRC_RC=n
CONFIG_CLOCK_CONTROL_NRF_K32SRC_SYNTH=y

CONFIG_GPIO_AS_PINRESET=n
CONFIG_NFCT_PINS_AS_GPIOS=y

CONFIG_ADC=y
CONFIG_ADC_ASYNC=y

CONFIG_FLASH=y
CONFIG_FLASH_PAGE_LAYOUT=y
CONFIG_NVS=y
CONFIG_MPU_ALLOW_FLASH_WRITE=y

CONFIG_SPI=y
CONFIG_PWM=y
```

## nrf52840dk_nrf52840.overlay
```dts
&spi0 {
	compatible = "nordic,nrf-spi";
	/* Cannot be used together with i2c0. */
	status = "disabled";
	sck-pin = <16>;
	mosi-pin = <20>;
	miso-pin = <18>;
};

&spi1 {
	compatible = "nordic,nrf-spi";
	status = "disabled";
	sck-pin = <16>;
	mosi-pin = <20>;
	miso-pin = <18>;
};

&spi2 {
	compatible = "nordic,nrf-spi";
	status = "disabled";
	sck-pin = <25>;
	mosi-pin = <23>;
	miso-pin = <24>;
};

&pwm0 {
	status = "okay";
	ch0-pin = <47>;
	ch0-inverted;
};
```

## nrf52dk_nrf52832.overlay
```dts
&spi0 {
	compatible = "nordic,nrf-spi";
	/* Cannot be used together with i2c0. */
	status = "disabled";
	sck-pin = <16>;
	mosi-pin = <20>;
	miso-pin = <18>;
};

&spi1 {
	compatible = "nordic,nrf-spi";
	status = "okay";
	sck-pin = <16>;
	mosi-pin = <20>;
	miso-pin = <18>;
};

&spi2 {
	compatible = "nordic,nrf-spi";
	status = "disabled";
	sck-pin = <25>;
	mosi-pin = <23>;
	miso-pin = <24>;
};
```

## src/als31300.c
```c
/*
	Copyright 2020 Benjamin Vedder	benjamin@vedder.se

	This program is free software: you can redistribute it and/or modify
    it under the terms of the GNU General Public License as published by
    the Free Software Foundation, either version 3 of the License, or
    (at your option) any later version.

    This program is distributed in the hope that it will be useful,
    but WITHOUT ANY WARRANTY; without even the implied warranty of
    MERCHANTABILITY or FITNESS FOR A PARTICULAR PURPOSE.  See the
    GNU General Public License for more details.

    You should have received a copy of the GNU General Public License
    along with this program.  If not, see <http://www.gnu.org/licenses/>.
    */

#include "als31300.h"
#include <string.h>

// Private functions
static uint8_t crc8(const uint8_t *data, uint8_t len);
static void init_reg(i2c_bb_state *i2c, uint16_t addr);

bool als31300_read_mag_xyz(i2c_bb_state *i2c, uint16_t addr, float *xyz) {
	uint8_t txbuf[2] = {0x28, 0x29};
	uint8_t r28[5], r29[5];

	i2c_bb_tx_rx(i2c, addr, txbuf, 1, r28, 5);
	i2c_bb_tx_rx(i2c, addr, txbuf + 1, 1, r29, 5);

	uint8_t crc_data[6] = {0x28, (addr << 1) + 1, 0, 0, 0, 0};
	memcpy(crc_data + 2, r28, 4);
	uint8_t crc1 = crc8(crc_data, 6);
	crc_data[0] = 0x29;
	memcpy(crc_data + 2, r29, 4);
	uint8_t crc2 = crc8(crc_data, 6);

	if (crc1 != r28[4] || crc2 != r29[4]) {
		init_reg(i2c, addr);
		return false;
	}

	int16_t x = (int16_t)((uint16_t)r28[0] << 8 | (((uint16_t)r29[1] << 4) & 0xF0)) / 16;
	int16_t y = (int16_t)((uint16_t)r28[1] << 8 | (((uint16_t)r29[2] << 0) & 0xF0)) / 16;
	int16_t z = (int16_t)((uint16_t)r28[2] << 8 | (((uint16_t)r29[2] << 4) & 0xF0)) / 16;

	/*
	 * 500G-version: 4
	 * 1000G version: 2
	 * 2000G-version: 1
	 */
	float scale = 1.0;

	xyz[0] = (float)x / scale;
	xyz[1] = (float)y / scale;
	xyz[2] = (float)z / scale;

	return true;
}

/**
 * Enter sleep mode.
 *
 * Sleep:
 * 0: Active mode
 * 1: Sleep mode
 * 2: Low-power duty-cycle mode
 */
bool als31300_sleep(i2c_bb_state *i2c, uint16_t addr, int sleep) {
	uint8_t txbuf[5] = {0x27, 0, 0, 0, sleep & 0x03};
	return i2c_bb_tx_rx(i2c, addr, txbuf, 5, 0, 0);
}

static void init_reg(i2c_bb_state *i2c, uint16_t addr) {
	uint8_t txbuf[1] = {0x02};
	uint8_t rxbuf[4];

	i2c_bb_tx_rx(i2c, addr, txbuf, 1, rxbuf, 4);

	// Send access code
	uint8_t txbuf2[5] = {0x35, 0x2c, 0x41, 0x35, 0x34};
	i2c_bb_tx_rx(i2c, addr, txbuf2, 5, 0, 0);

	txbuf2[0] = 0x02;

	rxbuf[1] |= (1 << 2); // Enable CRC

	rxbuf[1] &= ~(1 << 3); // Single ended hall mode
	rxbuf[1] &= ~(1 << 4); // Single ended hall mode

	rxbuf[1] &= ~(1 << 5); // Lowest bandwidth
	rxbuf[1] &= ~(1 << 6); // Lowest bandwidth
	rxbuf[1] &= ~(1 << 7); // Lowest bandwidth

	rxbuf[2] |= (1 << 0); // Enable CH_Z
	rxbuf[2] |= (1 << 1); // 1.8V I2C Mode
	rxbuf[3] |= (1 << 6); // Enable CH_X
	rxbuf[3] |= (1 << 7); // Enable CH_Y

	memcpy(txbuf2 + 1, rxbuf, 4);
	i2c_bb_tx_rx(i2c, addr, txbuf2, 5, 0, 0);
}

static uint8_t crc8(const uint8_t *data, uint8_t len)  {
	const uint8_t poly = 0x07;
	uint8_t crc = 0x00;

	for (uint8_t j = 0;j < len;j++) {
		crc ^= *data++;

		for (uint8_t i = 8; i; --i) {
			crc = (crc & 0x80) ? (crc << 1) ^ poly : (crc << 1);
		}
	}

	return crc;
}
```

## src/als31300.h
```c
/*
	Copyright 2020 Benjamin Vedder	benjamin@vedder.se

	This program is free software: you can redistribute it and/or modify
    it under the terms of the GNU General Public License as published by
    the Free Software Foundation, either version 3 of the License, or
    (at your option) any later version.

    This program is distributed in the hope that it will be useful,
    but WITHOUT ANY WARRANTY; without even the implied warranty of
    MERCHANTABILITY or FITNESS FOR A PARTICULAR PURPOSE.  See the
    GNU General Public License for more details.

    You should have received a copy of the GNU General Public License
    along with this program.  If not, see <http://www.gnu.org/licenses/>.
    */

#ifndef SRC_MAG_THROTTLE_ALS31300_H_
#define SRC_MAG_THROTTLE_ALS31300_H_

#include <stdint.h>
#include <stdbool.h>

#include "i2c_bb.h"

/*
 * ADR0 is GND on the boards and ADR1 is 0 or 1. This gives
 * the addresses 96 and 108 (decimal)
 */

bool als31300_read_mag_xyz(i2c_bb_state *i2c, uint16_t addr, float *xyz);
bool als31300_sleep(i2c_bb_state *i2c, uint16_t addr, int sleep);

#endif /* SRC_MAG_THROTTLE_ALS31300_H_ */
```

## src/conf_general.h
```c
/*
	Copyright 2020 Benjamin Vedder	benjamin@vedder.se

	This program is free software: you can redistribute it and/or modify
    it under the terms of the GNU General Public License as published by
    the Free Software Foundation, either version 3 of the License, or
    (at your option) any later version.

    This program is distributed in the hope that it will be useful,
    but WITHOUT ANY WARRANTY; without even the implied warranty of
    MERCHANTABILITY or FITNESS FOR A PARTICULAR PURPOSE.  See the
    GNU General Public License for more details.

    You should have received a copy of the GNU General Public License
    along with this program.  If not, see <http://www.gnu.org/licenses/>.
    */

#ifndef SRC_CONF_GENERAL_H_
#define SRC_CONF_GENERAL_H_

// Firmware version
#define FW_MAJOR		1
#define FW_MINOR		4

// Pin definitions
#ifdef WAND_DW

// Push buttons
#define SW1_PIN			NRF_GPIO_PIN_MAP(0, 4)
#define SW1_PIN2		NRF_GPIO_PIN_MAP(0, 4)
#define SW2_PIN			NRF_GPIO_PIN_MAP(0, 3)

// Magnetic field sensor joystick
#define PIN_ALS_SDA		NRF_GPIO_PIN_MAP(0, 8)
#define PIN_ALS_SCL		NRF_GPIO_PIN_MAP(0, 7)

// LIS2DH12 Accelerometer (in DWM1001)
#define PIN_LIS_SDA		NRF_GPIO_PIN_MAP(0, 29)
#define PIN_LIS_SCL		NRF_GPIO_PIN_MAP(0, 28)
#define LIS_I2C_ADDR	0x19

// IMU pins (wrong on rev0)
#define PIN_IMU_SCL		NRF_GPIO_PIN_MAP(0, 28)
#define PIN_IMU_SDA		NRF_GPIO_PIN_MAP(0, 29)

// Oled pins
#define OLED_PIN_RES	NRF_GPIO_PIN_MAP(0, 11)
#define OLED_PIN_CS		NRF_GPIO_PIN_MAP(0, 5)
#define OLED_PIN_D0		NRF_GPIO_PIN_MAP(0, 13)
#define OLED_PIN_D1		NRF_GPIO_PIN_MAP(0, 23)
#define OLED_PIN_DC		NRF_GPIO_PIN_MAP(0, 27)
#define OLED_PIN_BOOST	NRF_GPIO_PIN_MAP(0, 9) // REV0: This is a wire bridge

// ADC Channels
#define ADC_CH_BATT		1

#elif defined(SABRE)

// Push buttons
#define SW1_PIN			NRF_GPIO_PIN_MAP(0, 4)
#define SW1_PIN2		NRF_GPIO_PIN_MAP(0, 4)
#define SW2_PIN			NRF_GPIO_PIN_MAP(0, 5)

// Magnetic field sensor joystick
#define PIN_ALS_SDA		NRF_GPIO_PIN_MAP(0, 31)
#define PIN_ALS_SCL		NRF_GPIO_PIN_MAP(1, 9)

// IMU pins
#define PIN_IMU_SCL		NRF_GPIO_PIN_MAP(1, 0)
#define PIN_IMU_SDA		NRF_GPIO_PIN_MAP(1, 1)

// Oled pins
#define OLED_PIN_RES	NRF_GPIO_PIN_MAP(0, 27)
#define OLED_PIN_CS		NRF_GPIO_PIN_MAP(0, 8)
#define OLED_PIN_D0		NRF_GPIO_PIN_MAP(0, 25)
#define OLED_PIN_D1		NRF_GPIO_PIN_MAP(0, 26)
#define OLED_PIN_DC		NRF_GPIO_PIN_MAP(1, 12)
#define OLED_PIN_BOOST	NRF_GPIO_PIN_MAP(0, 3)

// ADC Channels
#define ADC_CH_BATT		1

#elif defined(WAND_MAG)

// Push buttons
#define SW1_PIN			NRF_GPIO_PIN_MAP(1, 1)
#define SW1_PIN2		NRF_GPIO_PIN_MAP(1, 1)
#define SW2_PIN			NRF_GPIO_PIN_MAP(0, 13)

// Magnetic field sensor joystick
#define PIN_ALS_SDA		NRF_GPIO_PIN_MAP(0, 29)
#define PIN_ALS_SCL		NRF_GPIO_PIN_MAP(1, 9)
#define PIN_ALS_EN		NRF_GPIO_PIN_MAP(0, 11)

#define PIN_IMU_SCL		NRF_GPIO_PIN_MAP(1, 2)
#define PIN_IMU_SDA		NRF_GPIO_PIN_MAP(1, 3)

// Oled pins
#define OLED_PIN_RES	NRF_GPIO_PIN_MAP(0, 27)
#define OLED_PIN_CS		NRF_GPIO_PIN_MAP(0, 8)
#define OLED_PIN_D0		NRF_GPIO_PIN_MAP(0, 25)
#define OLED_PIN_D1		NRF_GPIO_PIN_MAP(0, 26)
#define OLED_PIN_DC		NRF_GPIO_PIN_MAP(1, 12)
#define OLED_PIN_BOOST	NRF_GPIO_PIN_MAP(0, 6)

// ADC Channels
#define ADC_CH_BATT		9

#else

// Push buttons
#define SW1_PIN			NRF_GPIO_PIN_MAP(0, 19)
#define SW1_PIN2		NRF_GPIO_PIN_MAP(1, 1)
#define SW2_PIN			NRF_GPIO_PIN_MAP(0, 13)

// Potentiometer joystick
#define JS_GND_PIN		NRF_GPIO_PIN_MAP(0, 21)
#define JS_C_PIN		NRF_GPIO_PIN_MAP(0, 2)

// IMU pins
#define PIN_IMU_SCL		NRF_GPIO_PIN_MAP(1, 2)
#define PIN_IMU_SDA		NRF_GPIO_PIN_MAP(1, 3)

// Oled pins
#define OLED_PIN_RES	NRF_GPIO_PIN_MAP(0, 27)
#define OLED_PIN_CS		NRF_GPIO_PIN_MAP(0, 8)
#define OLED_PIN_D0		NRF_GPIO_PIN_MAP(0, 25)
#define OLED_PIN_D1		NRF_GPIO_PIN_MAP(0, 26)
#define OLED_PIN_DC		NRF_GPIO_PIN_MAP(1, 12)
#define OLED_PIN_BOOST	NRF_GPIO_PIN_MAP(0, 6)

// ADC Channels
#define ADC_CH_JS		1
#define ADC_CH_BATT		9 // 9 is internal VDD
#endif

// Macros
#define SW1				(!nrf_gpio_pin_read(SW1_PIN) || !nrf_gpio_pin_read(SW1_PIN2))
#define SW2				!nrf_gpio_pin_read(SW2_PIN)

#ifdef JS_GND_PIN
#define JS_OFF()		nrf_gpio_pin_set(JS_GND_PIN)
#define JS_ON()			nrf_gpio_pin_clear(JS_GND_PIN)
#else
#define JS_OFF()
#define JS_ON()
#endif

#endif /* SRC_CONF_GENERAL_H_ */
```

## src/crc.c
```c
/*
	Copyright 2012-2014 Benjamin Vedder	benjamin@vedder.se

	This program is free software: you can redistribute it and/or modify
    it under the terms of the GNU General Public License as published by
    the Free Software Foundation, either version 3 of the License, or
    (at your option) any later version.

    This program is distributed in the hope that it will be useful,
    but WITHOUT ANY WARRANTY; without even the implied warranty of
    MERCHANTABILITY or FITNESS FOR A PARTICULAR PURPOSE.  See the
    GNU General Public License for more details.

    You should have received a copy of the GNU General Public License
    along with this program.  If not, see <http://www.gnu.org/licenses/>.
    */

/*
 * crc.c
 *
 *  Created on: 26 feb 2012
 *      Author: benjamin
 */
#include "crc.h"

// CRC Table
const unsigned short crc16_tab[] = { 0x0000, 0x1021, 0x2042, 0x3063, 0x4084,
		0x50a5, 0x60c6, 0x70e7, 0x8108, 0x9129, 0xa14a, 0xb16b, 0xc18c, 0xd1ad,
		0xe1ce, 0xf1ef, 0x1231, 0x0210, 0x3273, 0x2252, 0x52b5, 0x4294, 0x72f7,
		0x62d6, 0x9339, 0x8318, 0xb37b, 0xa35a, 0xd3bd, 0xc39c, 0xf3ff, 0xe3de,
		0x2462, 0x3443, 0x0420, 0x1401, 0x64e6, 0x74c7, 0x44a4, 0x5485, 0xa56a,
		0xb54b, 0x8528, 0x9509, 0xe5ee, 0xf5cf, 0xc5ac, 0xd58d, 0x3653, 0x2672,
		0x1611, 0x0630, 0x76d7, 0x66f6, 0x5695, 0x46b4, 0xb75b, 0xa77a, 0x9719,
		0x8738, 0xf7df, 0xe7fe, 0xd79d, 0xc7bc, 0x48c4, 0x58e5, 0x6886, 0x78a7,
		0x0840, 0x1861, 0x2802, 0x3823, 0xc9cc, 0xd9ed, 0xe98e, 0xf9af, 0x8948,
		0x9969, 0xa90a, 0xb92b, 0x5af5, 0x4ad4, 0x7ab7, 0x6a96, 0x1a71, 0x0a50,
		0x3a33, 0x2a12, 0xdbfd, 0xcbdc, 0xfbbf, 0xeb9e, 0x9b79, 0x8b58, 0xbb3b,
		0xab1a, 0x6ca6, 0x7c87, 0x4ce4, 0x5cc5, 0x2c22, 0x3c03, 0x0c60, 0x1c41,
		0xedae, 0xfd8f, 0xcdec, 0xddcd, 0xad2a, 0xbd0b, 0x8d68, 0x9d49, 0x7e97,
		0x6eb6, 0x5ed5, 0x4ef4, 0x3e13, 0x2e32, 0x1e51, 0x0e70, 0xff9f, 0xefbe,
		0xdfdd, 0xcffc, 0xbf1b, 0xaf3a, 0x9f59, 0x8f78, 0x9188, 0x81a9, 0xb1ca,
		0xa1eb, 0xd10c, 0xc12d, 0xf14e, 0xe16f, 0x1080, 0x00a1, 0x30c2, 0x20e3,
		0x5004, 0x4025, 0x7046, 0x6067, 0x83b9, 0x9398, 0xa3fb, 0xb3da, 0xc33d,
		0xd31c, 0xe37f, 0xf35e, 0x02b1, 0x1290, 0x22f3, 0x32d2, 0x4235, 0x5214,
		0x6277, 0x7256, 0xb5ea, 0xa5cb, 0x95a8, 0x8589, 0xf56e, 0xe54f, 0xd52c,
		0xc50d, 0x34e2, 0x24c3, 0x14a0, 0x0481, 0x7466, 0x6447, 0x5424, 0x4405,
		0xa7db, 0xb7fa, 0x8799, 0x97b8, 0xe75f, 0xf77e, 0xc71d, 0xd73c, 0x26d3,
		0x36f2, 0x0691, 0x16b0, 0x6657, 0x7676, 0x4615, 0x5634, 0xd94c, 0xc96d,
		0xf90e, 0xe92f, 0x99c8, 0x89e9, 0xb98a, 0xa9ab, 0x5844, 0x4865, 0x7806,
		0x6827, 0x18c0, 0x08e1, 0x3882, 0x28a3, 0xcb7d, 0xdb5c, 0xeb3f, 0xfb1e,
		0x8bf9, 0x9bd8, 0xabbb, 0xbb9a, 0x4a75, 0x5a54, 0x6a37, 0x7a16, 0x0af1,
		0x1ad0, 0x2ab3, 0x3a92, 0xfd2e, 0xed0f, 0xdd6c, 0xcd4d, 0xbdaa, 0xad8b,
		0x9de8, 0x8dc9, 0x7c26, 0x6c07, 0x5c64, 0x4c45, 0x3ca2, 0x2c83, 0x1ce0,
		0x0cc1, 0xef1f, 0xff3e, 0xcf5d, 0xdf7c, 0xaf9b, 0xbfba, 0x8fd9, 0x9ff8,
		0x6e17, 0x7e36, 0x4e55, 0x5e74, 0x2e93, 0x3eb2, 0x0ed1, 0x1ef0 };

unsigned short crc16_2(unsigned char *buf, unsigned int len) {
	unsigned int i;
	unsigned short cksum = 0;
	for (i = 0; i < len; i++) {
		cksum = crc16_tab[(((cksum >> 8) ^ *buf++) & 0xFF)] ^ (cksum << 8);
	}
	return cksum;
}
```

## src/crc.h
```c
/*
	Copyright 2012-2014 Benjamin Vedder	benjamin@vedder.se

	This program is free software: you can redistribute it and/or modify
    it under the terms of the GNU General Public License as published by
    the Free Software Foundation, either version 3 of the License, or
    (at your option) any later version.

    This program is distributed in the hope that it will be useful,
    but WITHOUT ANY WARRANTY; without even the implied warranty of
    MERCHANTABILITY or FITNESS FOR A PARTICULAR PURPOSE.  See the
    GNU General Public License for more details.

    You should have received a copy of the GNU General Public License
    along with this program.  If not, see <http://www.gnu.org/licenses/>.
    */

/*
 * crc.h
 *
 *  Created on: 26 feb 2012
 *      Author: benjamin
 */

#ifndef CRC_H_
#define CRC_H_

/*
 * Functions
 */
unsigned short crc16_2(unsigned char *buf, unsigned int len);

#endif /* CRC_H_ */
```

## src/datatypes.h
```c
/*
	Copyright 2019 Benjamin Vedder	benjamin@vedder.se

	This program is free software: you can redistribute it and/or modify
    it under the terms of the GNU General Public License as published by
    the Free Software Foundation, either version 3 of the License, or
    (at your option) any later version.

    This program is distributed in the hope that it will be useful,
    but WITHOUT ANY WARRANTY; without even the implied warranty of
    MERCHANTABILITY or FITNESS FOR A PARTICULAR PURPOSE.  See the
    GNU General Public License for more details.

    You should have received a copy of the GNU General Public License
    along with this program.  If not, see <http://www.gnu.org/licenses/>.
    */

#ifndef DATATYPES_H_
#define DATATYPES_H_

#include <stdint.h>
#include <stdbool.h>
#include <stddef.h>

typedef struct {
	float q0;
	float q1;
	float q2;
	float q3;
	float integralFBx;
	float integralFBy;
	float integralFBz;
	float accMagP;
	int initialUpdateDone;
} ATTITUDE_INFO;

typedef enum {
	PACKET_PRINT = 0,
	PACKET_RB_STATUS,
	PACKET_IMU_SAMPLES,
	PACKET_TIME_ADJUST,
	PACKET_TIME_NOW,
	PACKET_BATTERY
} PACKET_COMMAND;

typedef struct {
	uint32_t time_ms_today;

	int16_t accX;
	int16_t accY;
	int16_t accZ;

	int16_t gyroX;
	int16_t gyroY;
	int16_t gyroZ;
} imu_samples;

// Datatypes
typedef enum {
	MOTE_PACKET_BATT_LEVEL = 0,
	MOTE_PACKET_BUTTONS,
	MOTE_PACKET_ALIVE,
	MOTE_PACKET_FILL_RX_BUFFER,
	MOTE_PACKET_FILL_RX_BUFFER_LONG,
	MOTE_PACKET_PROCESS_RX_BUFFER,
	MOTE_PACKET_PROCESS_SHORT_BUFFER,
	MOTE_PACKET_PAIRING_INFO
} MOTE_PACKET;

typedef struct {
	int rx_cnt;
	float battery_level;
	float speed;
	float distance;
	float temp_fet;
	float temp_motor;
	float wh_left;
	float wh_used;
	float wh_charged;
	float curr_prop;
} vesc_values_t;

#endif /* DATATYPES_H_ */
```

## src/fonts.h
```c
/*
	Copyright 2019 Benjamin Vedder	benjamin@vedder.se

	This program is free software: you can redistribute it and/or modify
    it under the terms of the GNU General Public License as published by
    the Free Software Foundation, either version 3 of the License, or
    (at your option) any later version.

    This program is distributed in the hope that it will be useful,
    but WITHOUT ANY WARRANTY; without even the implied warranty of
    MERCHANTABILITY or FITNESS FOR A PARTICULAR PURPOSE.  See the
    GNU General Public License for more details.

    You should have received a copy of the GNU General Public License
    along with this program.  If not, see <http://www.gnu.org/licenses/>.
    */

#ifndef SRC_FONTS_H_
#define SRC_FONTS_H_

#include <stdint.h>

extern const uint8_t font_aa_8x16[];
extern const uint8_t font_aa_9x13[];
extern const uint8_t font_aa_10x15[];
extern const uint8_t font_aa_11x21[];
extern const uint8_t font_aa_16x24[];
extern const uint8_t image_boot[];

extern const uint8_t font_aa_25x45[];
extern const uint8_t image_dial[];
extern const uint8_t image_map_up[];
extern const uint8_t image_bg_0[];
extern const uint8_t image_bg_1[];
extern const uint8_t image_bg_2[];
extern const uint8_t image_vesc_65_16[];

#endif /* SRC_FONTS_H_ */
```

## src/i2c_bb.c
```c
/*
	Copyright 2019 Benjamin Vedder	benjamin@vedder.se

	This file is part of the VESC firmware.

	The VESC firmware is free software: you can redistribute it and/or modify
    it under the terms of the GNU General Public License as published by
    the Free Software Foundation, either version 3 of the License, or
    (at your option) any later version.

    The VESC firmware is distributed in the hope that it will be useful,
    but WITHOUT ANY WARRANTY; without even the implied warranty of
    MERCHANTABILITY or FITNESS FOR A PARTICULAR PURPOSE.  See the
    GNU General Public License for more details.

    You should have received a copy of the GNU General Public License
    along with this program.  If not, see <http://www.gnu.org/licenses/>.
 */

#include "i2c_bb.h"
#include <hal/nrf_gpio.h>
#include <zephyr.h>

// This is based on https://en.wikipedia.org/wiki/I%C2%B2C

// Macros
#define SDA_LOW()				nrf_gpio_cfg_output(s->sda_pin);
#define SDA_HIGH()				nrf_gpio_cfg_input(s->sda_pin, NRF_GPIO_PIN_PULLUP);
#define SCL_LOW()				nrf_gpio_cfg_output(s->scl_pin);
#define SCL_HIGH()				nrf_gpio_cfg_input(s->scl_pin, NRF_GPIO_PIN_PULLUP);
#define READ_SDA()				nrf_gpio_pin_read(s->sda_pin)
#define READ_SCL()				nrf_gpio_pin_read(s->scl_pin)

// Private functions
static void i2c_start_cond(i2c_bb_state *s);
static void i2c_stop_cond(i2c_bb_state *s);
static void i2c_write_bit(i2c_bb_state *s, bool bit);
static bool i2c_read_bit(i2c_bb_state *s);
static bool i2c_write_byte(i2c_bb_state *s, bool send_start, bool send_stop, unsigned char byte);
static unsigned char i2c_read_byte(i2c_bb_state *s, bool nack, bool send_stop);
static bool clock_stretch_timeout(i2c_bb_state *s);
static void i2c_delay(void);

void i2c_bb_init(i2c_bb_state *s) {
	nrf_gpio_pin_clear(s->scl_pin);
	nrf_gpio_pin_clear(s->sda_pin);
	s->has_started = false;
	s->has_error = false;
}

void i2c_bb_restore_bus(i2c_bb_state *s) {
	SCL_HIGH();
	SDA_HIGH();

	k_busy_wait(10);

	for(int i = 0;i < 16;i++) {
		SCL_LOW();
		k_busy_wait(10);
		SCL_HIGH();
		k_busy_wait(10);
	}

	s->has_started = false;

	i2c_start_cond(s);
	i2c_stop_cond(s);

	s->has_error = false;
}

bool i2c_bb_tx_rx(i2c_bb_state *s, uint16_t addr, uint8_t *txbuf, size_t txbytes, uint8_t *rxbuf, size_t rxbytes) {
	s->has_error = 0;

	i2c_write_byte(s, true, false, addr << 1);

	for (unsigned int i = 0;i < txbytes;i++) {
		i2c_write_byte(s, false, false, txbuf[i]);
	}

	if (rxbytes > 0) {
		i2c_write_byte(s, true, false, addr << 1 | 1);

		for (unsigned int i = 0;i < rxbytes;i++) {
			rxbuf[i] = i2c_read_byte(s, i == (rxbytes - 1), false);
		}
	}

	i2c_stop_cond(s);

	return !s->has_error;
}

static void i2c_start_cond(i2c_bb_state *s) {
	if (s->has_started) {
		// if started, do a restart condition
		SDA_HIGH();
		i2c_delay();
		SCL_HIGH();

		if (!clock_stretch_timeout(s)) {
			return;
		}

		// Repeated start setup time, minimum 4.7us
		i2c_delay();
	}

	if (READ_SDA() == 0) {
//		arbitration_lost();
		s->has_error = true;
	}

	// SCL is high, set SDA from 1 to 0.
	SDA_LOW();
	i2c_delay();
	SCL_LOW();
	s->has_started = true;
}

static void i2c_stop_cond(i2c_bb_state *s) {
	SDA_LOW();
	i2c_delay();

	SCL_HIGH();

	if (!clock_stretch_timeout(s)) {
		return;
	}

	// Stop bit setup time, minimum 4us
	i2c_delay();

	// SCL is high, set SDA from 0 to 1
	SDA_HIGH();

	i2c_delay();

	if (READ_SDA() == 0) {
//		arbitration_lost();
		s->has_error = true;
	}

	s->has_started = false;
}

static void i2c_write_bit(i2c_bb_state *s, bool bit) {
	if (bit) {
		SDA_HIGH();
	} else {
		SDA_LOW();
	}

	// SDA change propagation delay
	i2c_delay();

	// Set SCL high to indicate a new valid SDA value is available
	SCL_HIGH();

	// Wait for SDA value to be read by slave, minimum of 4us for standard mode
	i2c_delay();

	if (!clock_stretch_timeout(s)) {
		return;
	}

	// SCL is high, now data is valid

	// If SDA is high, check that nobody else is driving SDA
	if (bit && (READ_SDA() == 0)) {
//		arbitration_lost();
		s->has_error = true;
	}

	// Clear the SCL to low in preparation for next change
	SCL_LOW();
}

static bool i2c_read_bit(i2c_bb_state *s) {
	bool bit;

	// Let the slave drive data
	SDA_HIGH();

	// Wait for SDA value to be written by slave, minimum of 4us for standard mode
	i2c_delay();

	// Set SCL high to indicate a new valid SDA value is available
	SCL_HIGH();

	if (!clock_stretch_timeout(s)) {
		return false;
	}

	// Wait for SDA value to be written by slave, minimum of 4us for standard mode
	i2c_delay();

	// SCL is high, read out bit
	bit = READ_SDA();

	// Set SCL low in preparation for next operation
	SCL_LOW();

	return bit;
}

static bool i2c_write_byte(i2c_bb_state *s, bool send_start, bool send_stop, unsigned char byte) {
	unsigned bit;
	bool nack;

	if (send_start) {
		i2c_start_cond(s);
	}

	for (bit = 0;bit < 8;bit++) {
		i2c_write_bit(s, (byte & 0x80) != 0);
		byte <<= 1;
	}

	nack = i2c_read_bit(s);

	if (send_stop) {
		i2c_stop_cond(s);
	}

	return nack;
}

static unsigned char i2c_read_byte(i2c_bb_state *s, bool nack, bool send_stop) {
	unsigned char byte = 0;
	unsigned char bit;

	for (bit = 0;bit < 8;bit++) {
		byte = (byte << 1) | i2c_read_bit(s);
	}

	i2c_write_bit(s, nack);

	if (send_stop) {
		i2c_stop_cond(s);
	}

	return byte;
}

static bool clock_stretch_timeout(i2c_bb_state *s) {
	volatile uint32_t cnt = 0;
	while(READ_SCL() == 0) {
		cnt++;

		if (cnt >= 6000000) {
			return false;
		}
	}

	return true;
}

static void i2c_delay(void) {
	k_busy_wait(1);
}
```

## src/lis2dh12.c
```c
/*
	Copyright 2021 Benjamin Vedder	benjamin@vedder.se

	This program is free software: you can redistribute it and/or modify
    it under the terms of the GNU General Public License as published by
    the Free Software Foundation, either version 3 of the License, or
    (at your option) any later version.

    This program is distributed in the hope that it will be useful,
    but WITHOUT ANY WARRANTY; without even the implied warranty of
    MERCHANTABILITY or FITNESS FOR A PARTICULAR PURPOSE.  See the
    GNU General Public License for more details.

    You should have received a copy of the GNU General Public License
    along with this program.  If not, see <http://www.gnu.org/licenses/>.
    */

#include "lis2dh12.h"

bool lis2dh12_init(i2c_bb_state *i2c, uint16_t addr) {
	// Power on
	uint8_t txbuf0[2] = {0x20, 0b01110111};
	i2c_bb_tx_rx(i2c, addr, txbuf0, 2, 0, 0);

	// HR Mode and +-16G
	uint8_t txbuf1[2] = {0x23, 0b00111000};
	i2c_bb_tx_rx(i2c, addr, txbuf1, 2, 0, 0);

	// Read reference to reset filters
	uint8_t txbuf[1] = {0x26};
	uint8_t rxbuf[1];
	return i2c_bb_tx_rx(i2c, addr, txbuf, 1, rxbuf, 1);
}

bool lis2dh12_read_acc_xyz(i2c_bb_state *i2c, uint16_t addr, float *xyz) {
	uint8_t txbuf[1] = {0x28 | 0x80};
	uint8_t rxbuf[6];
	bool okacc = i2c_bb_tx_rx(i2c, addr, txbuf, 1, rxbuf, 6);

	if (okacc) {
		xyz[0] = ((float)((int16_t)((uint16_t)rxbuf[0] | (uint16_t)rxbuf[1] << 8) >> 4)) * 12.0 / 1000.0;
		xyz[1] = ((float)((int16_t)((uint16_t)rxbuf[2] | (uint16_t)rxbuf[3] << 8) >> 4)) * 12.0 / 1000.0;
		xyz[2] = ((float)((int16_t)((uint16_t)rxbuf[4] | (uint16_t)rxbuf[5] << 8) >> 4)) * 12.0 / 1000.0;
	}

	return okacc;
}

bool lis2dh12_sleep(i2c_bb_state *i2c, uint16_t addr) {
	uint8_t txbuf0[2] = {0x20, 0b00000000};
	return i2c_bb_tx_rx(i2c, addr, txbuf0, 2, 0, 0);
}
```

## src/lis2dh12.h
```c
/*
	Copyright 2021 Benjamin Vedder	benjamin@vedder.se

	This program is free software: you can redistribute it and/or modify
    it under the terms of the GNU General Public License as published by
    the Free Software Foundation, either version 3 of the License, or
    (at your option) any later version.

    This program is distributed in the hope that it will be useful,
    but WITHOUT ANY WARRANTY; without even the implied warranty of
    MERCHANTABILITY or FITNESS FOR A PARTICULAR PURPOSE.  See the
    GNU General Public License for more details.

    You should have received a copy of the GNU General Public License
    along with this program.  If not, see <http://www.gnu.org/licenses/>.
    */

#ifndef SRC_LIS2DH12_H_
#define SRC_LIS2DH12_H_

#include <stdint.h>
#include <stdbool.h>

#include "i2c_bb.h"

/**
 * Address in the DMW1001 is 0x19
 */

bool lis2dh12_init(i2c_bb_state *i2c, uint16_t addr);
bool lis2dh12_read_acc_xyz(i2c_bb_state *i2c, uint16_t addr, float *xyz);
bool lis2dh12_sleep(i2c_bb_state *i2c, uint16_t addr);


#endif /* SRC_LIS2DH12_H_ */
```
